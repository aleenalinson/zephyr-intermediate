## CMakeLists.txt
```
cmake_minimum_required(VERSION 3.20.0)
find_package(Zephyr REQUIRED HINTS $ENV{ZEPHYR_BASE})

project(temp_alarm_unit_test)

target_sources(app PRIVATE
    src/sensor_fake.c
    src/test_basic.c
    src/test_error_paths.c
    ${CMAKE_CURRENT_SOURCE_DIR}/../../app/modules/temp_alarm/src/temp_alarm.c
)

target_include_directories(app PRIVATE
    ${CMAKE_CURRENT_SOURCE_DIR}/../../app/modules/temp_alarm/include
    include
)
```

## prj.conf
```kconfig
# Enable the Ztest unit testing framework
CONFIG_ZTEST=y

# Increase stack size for test threads to avoid hitting limits during test execution
CONFIG_ZTEST_STACK_SIZE=4096

# Randomize suite and test order to catch ordering dependencies early
CONFIG_ZTEST_SHUFFLE=y

# Enable logging for debugging test failures
CONFIG_LOG=y

# Sensor subsystem: required to compile sensor.h types and z_impl_* helpers
CONFIG_SENSOR=y
```

## include/sensor_fake.h
```c
/*
 * Sensor Fake - FFF fakes behind a fake struct device
 */

#ifndef SENSOR_FAKE_H
#define SENSOR_FAKE_H

#include <zephyr/device.h>
#include <zephyr/drivers/sensor.h>
#include <zephyr/fff.h>

/* FFF fake for sensor_driver_api.sample_fetch. */
DECLARE_FAKE_VALUE_FUNC(int, fake_sensor_sample_fetch, const struct device *,
                        enum sensor_channel);

/* FFF fake for sensor_driver_api.channel_get. */
DECLARE_FAKE_VALUE_FUNC(int, fake_sensor_channel_get, const struct device *, enum sensor_channel,
			struct sensor_value *);

/** The fake sensor device the tests pass to temp_alarm_init(). */
extern struct device fake_sensor_dev;

/** @brief Set the temperature, in whole degrees Celsius, that channel_get returns. */
void sensor_fake_set_temperature(int temp_celsius);

/**
 * @brief Install the custom_fake on fake_sensor_channel_get.
 *
 * Call it after sensor_fake_reset(), because RESET_FAKE() clears custom_fake.
 */
void sensor_fake_init(void);

/** @brief Reset every FFF fake, the call history and the simulated temperature. */
void sensor_fake_reset(void);

#endif /* SENSOR_FAKE_H */
```

## src/sensor_fake.c
```c
/*
 * Sensor Fake - definitions, simulated temperature and the fake device
 */

#include "sensor_fake.h"

#include <zephyr/fff.h>
#include <zephyr/toolchain.h>

/* Exactly one of these per test binary. */
DEFINE_FFF_GLOBALS;

DEFINE_FAKE_VALUE_FUNC(int, fake_sensor_sample_fetch, const struct device *,
                       enum sensor_channel);

DEFINE_FAKE_VALUE_FUNC(int, fake_sensor_channel_get, const struct device *, enum sensor_channel,
		       struct sensor_value *);

/* ---- Simulated sensor state ---------------------------------------------- */

static int sim_temperature;

/*
 * Writes the simulated temperature into the caller's sensor_value. val1 holds
 * the whole degrees; val2 (millionths) is not used, so it is set to 0.
 */
static int custom_sensor_channel_get(const struct device *dev, enum sensor_channel chan,
				     struct sensor_value *val)
{
	ARG_UNUSED(dev);
	ARG_UNUSED(chan);

	val->val1 = sim_temperature;
	val->val2 = 0;

	return 0;
}

/* ---- Fake sensor device -------------------------------------------------- */

/* The API table temp_alarm.c calls through. */
static const struct sensor_driver_api fake_sensor_api = {
	.sample_fetch = fake_sensor_sample_fetch,
	.channel_get = fake_sensor_channel_get,
};

/* initialized = 1 and init_res = 0 make device_is_ready() return true. */
static struct device_state fake_sensor_state = {
	.init_res = 0,
	.initialized = 1,
};

struct device fake_sensor_dev = {
	.name = "fake_sensor",
	.api = &fake_sensor_api,
	.state = &fake_sensor_state,
};

/* ---- Public helpers ------------------------------------------------------ */

void sensor_fake_set_temperature(int temp_celsius)
{
	sim_temperature = temp_celsius;
}

void sensor_fake_init(void)
{
	fake_sensor_channel_get_fake.custom_fake = custom_sensor_channel_get;
}

void sensor_fake_reset(void)
{
	RESET_FAKE(fake_sensor_sample_fetch);
	RESET_FAKE(fake_sensor_channel_get);
	FFF_RESET_HISTORY();

	sim_temperature = 0;
}
```

## src/test_basic.c
```c
/*
 * temp_alarm - Happy-path unit tests (homework skeleton)
 *
 * test_status_after_init is provided as a worked example. Finish Task 0 first,
 * then fill in the Task 1 stubs according to TEST_SPEC.md. The stubs call
 * ztest_test_skip(), so the binary builds and runs cleanly until each test is
 * implemented.
 *
 * Run:
 *   west twister -T tests/temp_alarm -p native_sim
 */

#include <errno.h>
#include <zephyr/fff.h>
#include <zephyr/ztest.h>

#include "sensor_fake.h"
#include "temp_alarm.h"

#define DEFAULT_THRESHOLD 30

/*
 * Shared by every suite: a clean fake, then the module initialised
 * with the fake device. temp_alarm_init() resets all module state,
 * so no deinit is needed between tests.
 */
static void before(void *fixture)
{
	ARG_UNUSED(fixture);

	sensor_fake_reset();
	sensor_fake_init();

	zassume_ok(temp_alarm_init(&fake_sensor_dev, DEFAULT_THRESHOLD),
		   "precondition: temp_alarm_init must succeed");
}

/*
 * ============================================================================
 * Test Suite: temp_alarm_get_status
 *
 * The status right after a successful init.
 * ============================================================================
 */
ZTEST_SUITE(temp_alarm_get_status, NULL, NULL, before, NULL, NULL);

/* PROVIDED — study this test before writing the rest. */
ZTEST(temp_alarm_get_status, test_status_after_init)
{
	struct temp_alarm_status status;

	zassert_ok(temp_alarm_get_status(&status), "get_status must succeed");

	zassert_equal(status.last_temp, 0, "last_temp must be 0 after init, got %d",
		      status.last_temp);
	zassert_equal(status.alarm_count, 0U, "alarm_count must be 0 after init, got %u",
		      status.alarm_count);
	zassert_false(status.is_alarming, "is_alarming must be false after init");
	zassert_equal(status.last_error, 0, "last_error must be 0 after init, got %d",
		      status.last_error);
}

/*
 * ============================================================================
 * Test Suite: temp_alarm_check
 *
 * Readings below, at and above the threshold.
 * ============================================================================
 */
ZTEST_SUITE(temp_alarm_check, NULL, NULL, before, NULL, NULL);

ZTEST(temp_alarm_check, test_below_threshold)
{
	struct temp_alarm_status status;

	sensor_fake_set_temperature(20);
	zassert_ok(temp_alarm_check(), "check at 20 C should succeed");
	zassert_ok(temp_alarm_get_status(&status), "get_status should succeed");

	zassert_equal(status.last_temp, 20, "last temperature should be 20 C");
	zassert_false(status.is_alarming, "20 C is below the threshold");
	zassert_equal(fake_sensor_sample_fetch_fake.call_count, 1,
		      "sample_fetch should be called exactly once");
	zassert_equal(fake_sensor_sample_fetch_fake.arg1_val, SENSOR_CHAN_AMBIENT_TEMP,
		      "sample_fetch should request ambient temperature");
	zassert_equal(fake_sensor_channel_get_fake.call_count, 1,
		      "channel_get should be called exactly once");
	zassert_equal(fake_sensor_channel_get_fake.arg1_val, SENSOR_CHAN_AMBIENT_TEMP,
		      "channel_get should request ambient temperature");
}

ZTEST(temp_alarm_check, test_at_threshold)
{
	struct temp_alarm_status status;

	sensor_fake_set_temperature(30);
	zassert_ok(temp_alarm_check(), "check at the threshold should succeed");
	zassert_ok(temp_alarm_get_status(&status), "get_status should succeed");

	zassert_false(status.is_alarming, "a reading equal to threshold is not an alarm");
	zassert_equal(status.alarm_count, 0U, "alarm count should remain zero");
}

ZTEST(temp_alarm_check, test_above_threshold)
{
	struct temp_alarm_status status;

	sensor_fake_set_temperature(40);
	zassert_ok(temp_alarm_check(), "check at 40 C should succeed");
	zassert_ok(temp_alarm_get_status(&status), "get_status should succeed");

	zassert_equal(status.last_temp, 40, "last temperature should be 40 C");
	zassert_true(status.is_alarming, "40 C is above the threshold");
	zassert_equal(status.alarm_count, 1U, "one alarming check should be counted");
}

/*
 * ============================================================================
 * Test Suite: temp_alarm_threshold
 *
 * Changing the threshold at run time.
 * ============================================================================
 */
ZTEST_SUITE(temp_alarm_threshold, NULL, NULL, before, NULL, NULL);

ZTEST(temp_alarm_threshold, test_new_threshold_clears_alarm)
{
	struct temp_alarm_status status;

	sensor_fake_set_temperature(40);
	zassert_ok(temp_alarm_check(), "first check should raise the alarm");
	zassert_ok(temp_alarm_get_status(&status), "get_status should succeed");
	zassert_true(status.is_alarming, "40 C should initially raise the alarm");

	zassert_ok(temp_alarm_set_threshold(50), "setting threshold to 50 C should succeed");
	zassert_ok(temp_alarm_get_status(&status), "get_status should succeed");
	zassert_false(status.is_alarming, "changing threshold should clear the alarm");

	zassert_ok(temp_alarm_check(), "second check should succeed");
	zassert_ok(temp_alarm_get_status(&status), "get_status should succeed");
	zassert_false(status.is_alarming, "40 C is below the new 50 C threshold");
	zassert_equal(status.alarm_count, 1U, "only the first check should count as an alarm");
}

/*
 * ============================================================================
 * Test Suite: temp_alarm_reset
 *
 * temp_alarm_reset() clears the alarm but keeps the last reading.
 * ============================================================================
 */
ZTEST_SUITE(temp_alarm_reset, NULL, NULL, before, NULL, NULL);

ZTEST(temp_alarm_reset, test_reset_clears_state)
{
	struct temp_alarm_status status;

	sensor_fake_set_temperature(40);
	zassert_ok(temp_alarm_check(), "first check should succeed");
	zassert_ok(temp_alarm_check(), "second check should succeed");
	zassert_ok(temp_alarm_check(), "third check should succeed");
	zassert_ok(temp_alarm_get_status(&status), "get_status should succeed");
	zassert_equal(status.alarm_count, 3U, "three alarming checks should be counted");

	temp_alarm_reset();
	zassert_ok(temp_alarm_get_status(&status), "get_status should succeed after reset");
	zassert_false(status.is_alarming, "reset should clear the alarm flag");
	zassert_equal(status.alarm_count, 0U, "reset should clear alarm count");
	zassert_equal(status.last_error, 0, "reset should clear the last error");
	zassert_equal(status.last_temp, 40, "reset should preserve the last temperature");
}
```

## src/test_error_paths.c
```c
/*
 * temp_alarm - Error-path unit tests (homework skeleton)
 *
 * Task 2: fill in the stubs according to TEST_SPEC.md. Each stub calls
 * ztest_test_skip(), so the binary builds and runs cleanly until the test is
 * implemented.
 *
 * Run:
 *   west twister -T tests/temp_alarm -p native_sim
 */

#include <errno.h>
#include <zephyr/fff.h>
#include <zephyr/ztest.h>

#include "sensor_fake.h"
#include "temp_alarm.h"

#define DEFAULT_THRESHOLD 30

/* Same before() hook as in test_basic.c: a clean fake and an initialised module. */
static void before(void *fixture)
{
	ARG_UNUSED(fixture);

	sensor_fake_reset();
	sensor_fake_init();

	zassume_ok(temp_alarm_init(&fake_sensor_dev, DEFAULT_THRESHOLD),
		   "precondition: temp_alarm_init must succeed");
}

/*
 * ============================================================================
 * Test Suite: temp_alarm_sensor_errors
 *
 * Failures from the sensor driver, injected through the fakes.
 * ============================================================================
 */
ZTEST_SUITE(temp_alarm_sensor_errors, NULL, NULL, before, NULL, NULL);

ZTEST(temp_alarm_sensor_errors, test_fetch_error_propagates)
{
	struct temp_alarm_status status;

	fake_sensor_sample_fetch_fake.return_val = -EIO;
	zassert_equal(temp_alarm_check(), -EIO, "fetch failure should propagate");
	zassert_equal(fake_sensor_channel_get_fake.call_count, 0,
		      "channel_get must not run after a failed fetch");
	zassert_ok(temp_alarm_get_status(&status), "get_status should succeed");
	zassert_equal(status.last_error, -EIO, "last_error should record fetch failure");
}

ZTEST(temp_alarm_sensor_errors, test_channel_get_error_propagates)
{
	struct temp_alarm_status status;

	/* Disable the successful custom callback so the fake's return value is used. */
	fake_sensor_channel_get_fake.custom_fake = NULL;
	fake_sensor_channel_get_fake.return_val = -EIO;

	zassert_equal(temp_alarm_check(), -EIO, "channel_get failure should propagate");
	zassert_equal(fake_sensor_sample_fetch_fake.call_count, 1,
		      "sample_fetch should still be called once");
	zassert_ok(temp_alarm_get_status(&status), "get_status should succeed");
	zassert_equal(status.last_error, -EIO, "last_error should record channel_get failure");
}

ZTEST(temp_alarm_sensor_errors, test_fail_then_recover)
{
	static int fetch_results[] = {-EIO, 0};
	struct temp_alarm_status status;

	SET_RETURN_SEQ(fake_sensor_sample_fetch, fetch_results, ARRAY_SIZE(fetch_results));
	sensor_fake_set_temperature(20);

	zassert_equal(temp_alarm_check(), -EIO, "first check should report fetch failure");
	zassert_ok(temp_alarm_check(), "second check should recover");
	zassert_ok(temp_alarm_get_status(&status), "get_status should succeed");

	zassert_equal(status.last_temp, 20, "successful retry should update last temperature");
	zassert_false(status.is_alarming, "20 C should not raise the alarm");
	zassert_equal(status.last_error, -EIO, "last error remains until reset");
}

/*
 * ============================================================================
 * Test Suite: temp_alarm_invalid_input
 *
 * Arguments the public API must reject.
 * ============================================================================
 */
ZTEST_SUITE(temp_alarm_invalid_input, NULL, NULL, before, NULL, NULL);

ZTEST(temp_alarm_invalid_input, test_get_status_null)
{
	zassert_equal(temp_alarm_get_status(NULL), -EINVAL,
		      "NULL status pointer should return -EINVAL");
}

ZTEST(temp_alarm_invalid_input, test_init_without_device)
{
	zassert_equal(temp_alarm_init(NULL, DEFAULT_THRESHOLD), -ENODEV,
		      "missing device should return -ENODEV");
}

ZTEST(temp_alarm_invalid_input, test_init_threshold_out_of_range)
{
	zassert_equal(temp_alarm_init(&fake_sensor_dev, -1), -EINVAL,
		      "negative init threshold should return -EINVAL");
	zassert_equal(temp_alarm_init(&fake_sensor_dev, 101), -EINVAL,
		      "init threshold above maximum should return -EINVAL");
}

ZTEST(temp_alarm_invalid_input, test_set_threshold_out_of_range)
{
	struct temp_alarm_status status;

	zassert_equal(temp_alarm_set_threshold(-1), -EINVAL,
		      "negative threshold should return -EINVAL");
	zassert_equal(temp_alarm_set_threshold(101), -EINVAL,
		      "threshold above maximum should return -EINVAL");

	/* A reading above the original 30 C threshold proves it was preserved. */
	sensor_fake_set_temperature(31);
	zassert_ok(temp_alarm_check(), "check should succeed with original threshold");
	zassert_ok(temp_alarm_get_status(&status), "get_status should succeed");
	zassert_true(status.is_alarming, "31 C should exceed the unchanged 30 C threshold");
	zassert_equal(status.alarm_count, 1U, "alarm should be counted once");
}
```
